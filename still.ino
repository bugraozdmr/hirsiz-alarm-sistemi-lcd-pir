#include <SPI.h>
#include <Adafruit_GFX.h>
#include <Adafruit_PCD8544.h>

//port 8 bozuk
//buzzer icin dusuk direnc secilsin 
const int kirmizi=10,yesil=11,buton1=2,buton2=9,sensor=13,buzzer=12;
bool alarm=false;

//hirsiz icon

const unsigned char hirsiz [] PROGMEM = {
	0xff, 0xff, 0xff, 0xff, 0xf0, 0x00, 0xff, 0xff, 0xff, 0xff, 0xf0, 0xff, 0xff, 0xff, 0xff, 0x00, 
	0x00, 0x0f, 0xff, 0xff, 0xff, 0xf0, 0xff, 0xff, 0xff, 0xfc, 0x00, 0x00, 0x03, 0xff, 0xff, 0xff, 
	0xf0, 0xff, 0xff, 0xff, 0xf0, 0x00, 0x00, 0x00, 0xff, 0xff, 0xff, 0xf0, 0xff, 0xff, 0xff, 0xe0, 
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	0x00, 0x00, 0x00, 0x00, 0x00, 0x00, 0x00, 0x00, 0x00, 0x00, 0x00, 0x00, 0x00, 0x00, 0x00, 0x00
};


Adafruit_PCD8544 display = Adafruit_PCD8544(7, 6, 5, 4, 3);   //pcd8544 uretici

void setup() {
  //Initialize Display
  Serial.begin(9600);
  pinMode(kirmizi,OUTPUT);
  pinMode(yesil,OUTPUT);
  pinMode(buzzer,OUTPUT);
  pinMode(buton1,INPUT);
  pinMode(buton2,INPUT);
  pinMode(sensor,INPUT);
  display.begin();
  display.clearDisplay();   //bu yapılmazsa basta cikan yildiz surekli cikar
  // you can change the contrast around to adapt the display for the best viewing!
  display.setContrast(100);
}
//belirleyici
int k=0;

void loop() {
  display.setCursor(0,0);
	display.setTextSize(2);
  //ilk calisma
  if(k==0) {
    display.println("");
    display.println("  *_*");
    display.println("");
    display.display();
    delay(100);
  }

	if(digitalRead(buton1)==1){
    alarm=true;
    display.println("");
    display.println(" aktif");
    display.display();
    delay(500);
    Serial.println("buton1");
    k+=2;    //tekrar ilk donguye girmesin diye
  }
  if(digitalRead(buton2)==1){
    alarm=false;
    display.println("");
    display.println(" pasif");
    display.display();
    delay(100);
    Serial.println("buton2");
    k+=2;   //tekrar ilk donguye girmesin diye
  }

  Serial.println(alarm);

  

  if(alarm==true){
    digitalWrite(yesil,1);
    digitalWrite(kirmizi,0);

    if(digitalRead(sensor)==1){
      //13. porta baglamadan calismadi
      while(digitalRead(buton2)!=1){
        display.clearDisplay();
        display.drawBitmap(0, 0,  hirsiz, 84, 48, BLACK);
        display.display();
        Serial.println("biri var");
        tone(buzzer,240);
        delay(250);
        noTone(buzzer);
        delay(250);
      }
    }else{    //alarm aktif ama kimse yoksa
      Serial.println("sensor yok");
      display.clearDisplay();
      display.setTextSize(1);
      display.println("kimseyi gormedim ben senden daha guzel...");
      display.display();
      delay(300);
    }
  }
  else{   //eger alarm aktif degilse
    digitalWrite(yesil,0);
    digitalWrite(kirmizi,1);
    delay(200);
  }

  
  //delay at unutmazsan
  
	display.clearDisplay();
}
